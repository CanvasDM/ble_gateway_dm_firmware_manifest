## west.yml
```yaml
manifest:
  remotes:
    - name: CanvasDM
      url-base: https://github.com/CanvasDM
    - name: LairdCP
      url-base: https://github.com/LairdCP

  # Please add items below based on alphabetical order.
  # These dependencies may need updating if new features are added to the firmware.
  projects:
    - name: app_source_file_template_module
      path: modules/lib/laird_connect/app_source_file_template
      revision: 77660b831cb70e02e6b9808f96d5f3fa621286e7
      remote: CanvasDM
    - name: Attributes
      path: modules/lib/laird_connect/attributes
      revision: 7c12c78a182fbce22af33fc1caeaa5830fb0db97
      remote: LairdCP
    - name: ble_gateway_device_manager_module
      path: modules/lib/laird_connect/ble_gateway_device_manager
      revision: a32ef9ba2067027f278e53e2444c13d6297e548b
      remote: CanvasDM
    - name: ble_gateway_dm_firmware
      revision: 5ca3cb1cee94843da38c2d37d3637ec046f602b8
      remote: CanvasDM
    - name: cmake_functions_module
      path: modules/lib/laird_connect/cmake_functions
      revision: 0f2eae9efac2078f6ac0fbc89f24a8992935e150
      remote: CanvasDM
    - name: jsmn_module
      path: modules/lib/jsmn
      revision: e534451c62d04eba5a6c6d9a93315255cf9dd399
      remote: CanvasDM
    - name: lcz_hw_key_module
      path: modules/lib/laird_connect/lcz_hw_key
      revision: 854ba1bf008c5269cf8b7b490e1ee6b6bafce6c3
      remote: CanvasDM
    - name: lcz_lwm2m_util_module
      path: modules/lib/laird_connect/lcz_lwm2m_util
      revision: 5a3152a10ac00317103a566f59ed36657831459d
      remote: CanvasDM
    - name: lcz_mqtt_module
      path: modules/lib/laird_connect/lcz_mqtt
      revision: 88bcd9ed819fd33b025a4d189b96b87ee08cbec0
      remote: CanvasDM
    - name: lcz_sensor_telemetry_app_module
      path: modules/lib/laird_connect/lcz_sensor_telemetry_app
      revision: 4bb9b8fac7c966ed32be2d9e5b47b8f69f49a520
      remote: CanvasDM
    - name: locking_module
      path: modules/lib/laird_connect/locking
      revision: ccac2d53d50ef9d4b28c962d94de3f615e46a9d8
      remote: CanvasDM
    - name: lwm2m_client_module
      path: modules/lib/laird_connect/lwm2m_client
      revision: 308a2a9511b8d5a72d9d5d055a59e1e06af2b8d6
      remote: CanvasDM
    - name: lwm2m_file_system_management_module
      path: modules/lib/laird_connect/lwm2m_file_system_management
      revision: 281da241a0ad397a1a53272c2fcc494707d9fc59
      remote: CanvasDM
    - name: lwm2m_connectivity_monitor_module
      revision: cf6450fb797eb613eaebc484942dd684edbe9624
      path: modules/lib/laird_connect/lwm2m_connectivity_monitor
      remote: CanvasDM
    - name: lwm2m_ipso_current_module
      path: modules/lib/laird_connect/lwm2m_ipso_current
      revision: 181a60b9e13c25a8b3f962f24576924686709e41
      remote: CanvasDM
    - name: lwm2m_ipso_pressure_module
      path: modules/lib/laird_connect/lwm2m_ipso_pressure
      revision: 1d455725088f63016995ad153c8bb46e8dd99fc7
      remote: CanvasDM
    - name: lwm2m_ipso_fill_level_module
      path: modules/lib/laird_connect/lwm2m_ipso_fill_level
      revision: 9e38b587ace96a4860835f800fae0ec30561ba69
      remote: CanvasDM
    - name: lwm2m_ipso_temperature_module
      path: modules/lib/laird_connect/lwm2m_ipso_temperature
      revision: 2b0a3112ae6d7fc54bbe895bd43f3a9bc3a28506
      remote: CanvasDM
    - name: lwm2m_firmware_update_module
      path: modules/lib/laird_connect/lwm2m_firmware_update
      revision: ae593439112c144db035c2ef1bd23eb399f53828
      remote: CanvasDM
    - name: lwm2m_gateway_obj_module
      path: modules/lib/laird_connect/lwm2m_gateway_obj
      revision: fea3b0cfa4b8e989f99d4c066f4d0114168fc084
      remote: CanvasDM
    - name: lwm2m_gateway_proxy_module
      path: modules/lib/laird_connect/lwm2m_gateway_proxy
      revision: 2ca132f7e4f230e97a5da479b873e50b64dca44d
      remote: CanvasDM
    - name: lwm2m_ucifi_battery_module
      path: modules/lib/laird_connect/lwm2m_ucifi_battery
      revision: 4a323b1a579660fbe48b8fcdda55814b88b9166c
      remote: CanvasDM
    - name: lwm2m_software_management_module
      path: modules/lib/laird_connect/lwm2m_software_management
      revision: 57c23a23000d458302a44a70e5885a6bc4c7e52d
      remote: CanvasDM
    - name: memfault-firmware-sdk
      path: modules/lib/memfault-firmware-sdk
      revision: 5a265a6078d9301e7416b18cd08bd7a2ea7afa3f
      remote: LairdCP
    - name: modem_hl7800_module
      path: modules/lib/laird_connect/modem_hl7800
      revision: 4500052f6ed124798a7155ca1438bab90fef3f52
      remote: CanvasDM
    - name: network_monitor_module
      path: modules/lib/laird_connect/network_monitor
      revision: bb7908926648ab07ee69c4308dfd3cf334cc5efe
      remote: CanvasDM
    - name: pki_auth_module
      path: modules/lib/laird_connect/pki_auth
      revision: d03ce25dbd16b27e3401de1fdf296fee89df53bb
      remote: CanvasDM
    - name: power_module
      path: modules/lib/laird_connect/power
      revision: a199216134a5aa96476b4fe881c951f0713e6089
      remote: CanvasDM
    - name: sdk-nrf
      path: nrf
      revision: 9a9d1a5c4f5483a7c55b259df69346b702987238
      remote: LairdCP
      import:
        # Please keep this list sorted alphabetically.
        name-blocklist:
          - Alexa-Gadgets-Embedded-Sample-Code
          - canopennode
          - cirrus
          - civetweb
          - connectedhomeip
          - find-my
          - hal_st
          - homekit
          - loramac-node
          - lvgl
          - matter
          - mbed-cloud-client
          - nrf-802154
          - openthread
          - sdk-lc3
    - name: shell_login_module
      path: modules/lib/laird_connect/shell_login
      revision: eb57e69107196b3e737b6863366235a33a2083e0
      remote: CanvasDM
    - name: shell_script_runner_module
      path: modules/lib/laird_connect/shell_script_runner
      revision: 62a27f8fdf5163efa811dd64112f7807375273a0
      remote: CanvasDM
    - name: system_message_task_module
      path: modules/lib/laird_connect/system_message_task
      revision: 2b306a77a09df6037635d1e7bd3520729e8c1d44
      remote: CanvasDM
    - name: zephyr
      revision: 0d75c808d0b6546b39602ab778ae16e39f2571fd
      remote: LairdCP
      import:
        # In addition to the zephyr repository itself, NCS also
        # imports the contents of zephyr/west.yml.
        # Only the projects explicitly named in the
        # following whitelist are imported.
        #
        # Note that the zephyr west extensions (like 'build', 'flash',
        # 'debug', etc.) are automatically provided by this import, so
        # there's no need to add a redundant west-commands: key for
        # the zephyr project.
        #
        # Please keep this list sorted alphabetically.
        name-allowlist:
          - cmsis
          - fatfs
          - hal_nordic
          - libmetal
          - littlefs
          - mbedtls
          - mcumgr
          - mipi-sys-t
          - net-tools
          - nrf_hw_models
          - open-amp
          - openthread
          - segger
          - tinycrypt
          - zcbor
    - name: zephyr_lib
      path: modules/lib/laird_connect/zephyr_lib
      revision: c5db60e1a3fd580671f793144d86089b56dfc600
      remote: LairdCP
    # Framework must be placed after all components
    - name: zephyr_framework
      path: modules/lib/laird_connect/framework
      revision: fce9383112ae2b308195e618ba51c5bed8e4c014
      remote: LairdCP
  self:
    path: ble_gateway_dm_firmware_public_manifest
```
